/**
 * lvgl_port.c — LVGL display driver + UI for the car_nav ILI9341 monitor.
 *
 * Initializes LVGL, plugs it into the existing ili9341 driver (flush
 * callback), and creates the UI objects the renderer uses:
 *   - a full-screen RGB565 canvas for the vector map
 *   - a top navigation banner (next street)
 *   - a bottom speed HUD
 *
 * Single-threaded: all LVGL calls happen on the app task; lvgl_refresh()
 * forces a synchronous flush.
 */
#include "lvgl_port.h"
#include "ili9341.h"
#include "disp_spi.h"

#include <stdio.h>

#include "esp_heap_caps.h"
#include "esp_log.h"

static const char *TAG = "lvgl_port";

/* Vietnamese-capable font (Arial, generated by lv_font_conv). */
extern const lv_font_t lv_font_viet_20;

#define W ILI9341_WIDTH
#define H ILI9341_HEIGHT
#define DRAW_BUF_ROWS 24 /* partial display buffer rows */

static lv_display_t *g_disp = NULL;
static lv_obj_t *g_canvas = NULL;
static lv_obj_t *g_banner = NULL;
static lv_obj_t *g_banner_label = NULL;
static lv_obj_t *g_hud = NULL;
static lv_obj_t *g_hud_label = NULL;
static uint8_t *g_draw_buf = NULL;

/* Send an LVGL dirty area to the ILI9341. The panel expects RGB565 with the
 * high byte first, so bytes are swapped in place (LVGL's draw buffer is
 * fully overwritten before each use, so in-place swap is safe). The pixels
 * are then pushed through the vendor's DMA pool (ili9341_flush), we wait for
 * the DMA to drain, and finally release the buffer back to LVGL. */
static void lvgl_flush_cb(lv_display_t *disp, const lv_area_t *area, uint8_t *px_map)
{
    size_t w = (size_t)(area->x2 - area->x1 + 1);
    size_t h = (size_t)(area->y2 - area->y1 + 1);
    size_t n = w * h;
    uint16_t *p = (uint16_t *)px_map;
    for (size_t i = 0; i < n; i++) {
        uint16_t c = p[i];
        p[i] = (uint16_t)((c >> 8) | (c << 8));
    }
    /* Vendor ILI9341 flush: set the window and queue the area via DMA */
    ili9341_flush(disp, area, px_map);
    /* Wait for the DMA transfer to drain, then release the buffer to LVGL */
    disp_wait_for_pending_transactions();
    lv_display_flush_ready(disp);
}

int lvgl_port_init(void)
{
    if (g_disp)
        return 0;

    lv_init();

    g_draw_buf = heap_caps_malloc((size_t)W * DRAW_BUF_ROWS * 2, MALLOC_CAP_8BIT);
    if (!g_draw_buf) {
        ESP_LOGE(TAG, "buffer alloc failed");
        return -1;
    }

    g_disp = lv_display_create(W, H);
    lv_display_set_flush_cb(g_disp, lvgl_flush_cb);
    lv_display_set_buffers(g_disp, g_draw_buf, NULL,
                           (uint32_t)W * DRAW_BUF_ROWS * 2,
                           LV_DISPLAY_RENDER_MODE_PARTIAL);

    /* ---- top navigation banner (next street) ---- */
    lv_obj_t *banner = lv_obj_create(lv_screen_active());
    lv_obj_set_size(banner, W, 30);
    lv_obj_set_pos(banner, 0, 0);
    lv_obj_set_style_bg_color(banner, lv_color_hex(0x3A3A3A), 0);
    lv_obj_set_style_bg_opa(banner, LV_OPA_COVER, 0);
    lv_obj_set_style_radius(banner, 0, 0);
    lv_obj_set_style_border_width(banner, 0, 0);
    lv_obj_set_style_pad_all(banner, 0, 0);
    lv_obj_remove_flag(banner, LV_OBJ_FLAG_SCROLLABLE);
    g_banner = banner;

    g_banner_label = lv_label_create(banner);
    lv_obj_center(g_banner_label);
    lv_obj_set_style_text_color(g_banner_label, lv_color_hex(0xFFFFFF), 0);
    lv_obj_set_style_text_font(g_banner_label, &lv_font_viet_20, 0);
    lv_label_set_text(g_banner_label, "");

    /* ---- bottom speed HUD ---- */
    lv_obj_t *hud = lv_obj_create(lv_screen_active());
    lv_obj_set_size(hud, W, 34);
    lv_obj_set_pos(hud, 0, H - 34);
    lv_obj_set_style_bg_color(hud, lv_color_hex(0x3A3A3A), 0);
    lv_obj_set_style_bg_opa(hud, LV_OPA_COVER, 0);
    lv_obj_set_style_radius(hud, 0, 0);
    lv_obj_set_style_pad_all(hud, 0, 0);
    lv_obj_set_style_border_width(hud, 1, 0);
    lv_obj_set_style_border_side(hud, LV_BORDER_SIDE_TOP, 0);
    lv_obj_set_style_border_color(hud, lv_color_hex(0x808080), 0);
    lv_obj_remove_flag(hud, LV_OBJ_FLAG_SCROLLABLE);
    g_hud = hud;

    g_hud_label = lv_label_create(hud);
    lv_obj_center(g_hud_label);
    lv_obj_set_style_text_color(g_hud_label, lv_color_hex(0xFFFFFF), 0);
    lv_obj_set_style_text_font(g_hud_label, &lv_font_viet_20, 0);
    lv_label_set_text(g_hud_label, "0 km/h");

    ESP_LOGI(TAG, "LVGL display ready (%dx%d)", W, H);
    return 0;
}

lv_obj_t *lvgl_port_create_canvas(void *buf)
{
    if (!buf)
        return NULL;
    g_canvas = lv_canvas_create(lv_screen_active());
    lv_obj_remove_style_all(g_canvas);
    lv_obj_set_pos(g_canvas, 0, 0);
    lv_canvas_set_buffer(g_canvas, buf, W, H, LV_COLOR_FORMAT_RGB565);
    return g_canvas;
}

void lvgl_set_banner(const char *ascii)
{
    if (!g_banner_label)
        return;
    lv_label_set_text(g_banner_label, ascii ? ascii : "");
}

void lvgl_banner_visible(bool on)
{
    if (!g_banner)
        return;
    if (on)
        lv_obj_remove_flag(g_banner, LV_OBJ_FLAG_HIDDEN);
    else
        lv_obj_add_flag(g_banner, LV_OBJ_FLAG_HIDDEN);
}

void lvgl_ui_foreground(void)
{
    if (g_banner)
        lv_obj_move_foreground(g_banner);
    if (g_hud)
        lv_obj_move_foreground(g_hud);
}

void lvgl_set_speed(int kmh)
{
    if (!g_hud_label)
        return;
    char buf[16];
    snprintf(buf, sizeof(buf), "%d km/h", kmh);
    lv_label_set_text(g_hud_label, buf);
}

void lvgl_refresh(void)
{
    if (!g_disp)
        return;
    lv_obj_invalidate(g_canvas);
    lv_refr_now(g_disp);
}

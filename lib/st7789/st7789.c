/**
 * ST7789 SPI TFT Display Driver – ESP-IDF implementation
 *
 * Optimized for maximum throughput:
 *   - SPI Mode 0 (CPOL=0, CPHA=0) per ST7789 datasheet
 *   - 80 MHz SPI clock via IOMUX native pins
 *   - Half-duplex (write-only, no MISO overhead)
 *   - DMA-backed async pixel transfers (CPU free during SPI)
 *   - pre_cb ISR callback for race-free DC pin control
 *   - SPI_TRANS_USE_TXDATA for ≤4-byte transfers (skip DMA setup)
 *   - Batched window-set: CASET/RASET data in single 4-byte txn
 */
#include "st7789.h"
#include <string.h>
#include "freertos/FreeRTOS.h"
#include "freertos/task.h"
#include "esp_log.h"
#include "esp_attr.h"

static const char *TAG = "st7789";
static spi_device_handle_t spi_dev = NULL;
static bool initialized = false;

/* ── ST7789 Command Set ──────────────────────────────── */
#define CMD_SWRESET  0x01
#define CMD_SLPIN    0x10
#define CMD_SLPOUT   0x11
#define CMD_NORON    0x13
#define CMD_INVON    0x21
#define CMD_DISPON   0x29
#define CMD_CASET    0x2A
#define CMD_RASET    0x2B
#define CMD_RAMWR    0x2C
#define CMD_MADCTL   0x36
#define CMD_COLMOD   0x3A

/* ═══════════════════════════════════════════════════════
 *  SPI pre-transfer callback (runs in ISR context)
 *  Sets DC pin from transaction->user field, synchronized
 *  with SPI hardware — no race condition.
 * ═══════════════════════════════════════════════════════ */
static void IRAM_ATTR lcd_pre_cb(spi_transaction_t *t)
{
    gpio_set_level(ST7789_PIN_DC, (int)(uintptr_t)t->user);
}

/* ═══════════════════════════════════════════════════════
 *  Blocking command/data helpers (for init & window-set)
 * ═══════════════════════════════════════════════════════ */

/** Send one command byte (DC=0). Blocking. */
static void lcd_cmd(uint8_t cmd)
{
    spi_transaction_t t = {
        .length = 8,
        .flags  = SPI_TRANS_USE_TXDATA,  /* ≤4 bytes: skip DMA */
        .user   = (void *)0,             /* DC = 0 → command */
    };
    t.tx_data[0] = cmd;
    spi_device_polling_transmit(spi_dev, &t);
}

/** Send data bytes (DC=1). Uses TXDATA for ≤4 bytes, DMA buffer otherwise. */
static void lcd_data(const uint8_t *buf, size_t len)
{
    if (!len) return;
    spi_transaction_t t = {
        .length = len * 8,
        .user   = (void *)1,             /* DC = 1 → data */
    };
    if (len <= 4) {
        t.flags = SPI_TRANS_USE_TXDATA;
        memcpy(t.tx_data, buf, len);
    } else {
        t.tx_buffer = buf;
    }
    spi_device_polling_transmit(spi_dev, &t);
}

static inline void lcd_data8(uint8_t v) { lcd_data(&v, 1); }

/* ═══════════════════════════════════════════════════════
 *  Async DMA pixel transfer
 *  Queue one large transfer, CPU returns immediately.
 *  Buffer must stay valid until st7789_wait_dma().
 * ═══════════════════════════════════════════════════════ */
static spi_transaction_t dma_txn;
static bool dma_pending = false;

void st7789_write_pixels_dma(const void *data, size_t len_bytes)
{
    /* Drain previous transfer first */
    st7789_wait_dma();

    memset(&dma_txn, 0, sizeof(dma_txn));
    dma_txn.length    = len_bytes * 8;
    dma_txn.tx_buffer = data;
    dma_txn.user      = (void *)1;       /* DC = 1 → pixel data */

    spi_device_queue_trans(spi_dev, &dma_txn, portMAX_DELAY);
    dma_pending = true;
}

void st7789_wait_dma(void)
{
    if (!dma_pending) return;
    spi_transaction_t *rt;
    spi_device_get_trans_result(spi_dev, &rt, portMAX_DELAY);
    dma_pending = false;
}

/* ═══════════════════════════════════════════════════════
 *  Hardware init
 * ═══════════════════════════════════════════════════════ */
esp_err_t st7789_init(void)
{
    if (initialized) return ESP_OK;

    /* ── GPIO setup: DC, RST, BL ── */
    gpio_config_t io = {
        .mode         = GPIO_MODE_OUTPUT,
        .pull_up_en   = GPIO_PULLUP_DISABLE,
        .pin_bit_mask = (1ULL << ST7789_PIN_DC),
    };
    gpio_config(&io);

    uint64_t mask = 0;
    if (ST7789_PIN_RST >= 0) mask |= (1ULL << ST7789_PIN_RST);
#if ST7789_PIN_BL >= 0
    mask |= (1ULL << ST7789_PIN_BL);
#endif
    if (mask) {
        io.pin_bit_mask = mask;
        gpio_config(&io);
    }

    /* Hardware reset pulse */
    if (ST7789_PIN_RST >= 0) {
        gpio_set_level(ST7789_PIN_RST, 0);
        vTaskDelay(pdMS_TO_TICKS(5));
        gpio_set_level(ST7789_PIN_RST, 1);
        vTaskDelay(pdMS_TO_TICKS(5));
    }

    /* ── SPI bus ──
     * IOMUX pins bypass GPIO matrix → direct peripheral path
     * Enables reliable 80 MHz clock (GPIO matrix caps at ~26 MHz) */
    spi_bus_config_t bus = {
        .mosi_io_num     = ST7789_PIN_MOSI,
        .miso_io_num     = -1,             /* write-only display */
        .sclk_io_num     = ST7789_PIN_SCLK,
        .quadwp_io_num   = -1,
        .quadhd_io_num   = -1,
        .max_transfer_sz = ST7789_WIDTH * ST7789_HEIGHT * 2,  /* full screen */
    };
    ESP_ERROR_CHECK(spi_bus_initialize(ST7789_SPI_HOST, &bus, SPI_DMA_CH_AUTO));

    /* ── SPI device ──
     * Mode 0: CPOL=0 CPHA=0 (per ST7789 datasheet, §9.2)
     * 80 MHz: achievable on IOMUX pins (reduce to 40M if unstable)
     * Half-duplex: no MISO → cleaner timing, no dummy bits */
    spi_device_interface_config_t dev = {
        .mode           = 0,                            /* MODE 0 per datasheet */
        .clock_speed_hz = SPI_MASTER_FREQ_40M,          /* 40 MHz (80M glitches on this wiring) */
        .spics_io_num   = ST7789_PIN_CS,
        .queue_size     = 1,
        .flags          = SPI_DEVICE_NO_DUMMY | SPI_DEVICE_HALFDUPLEX,
        .pre_cb         = lcd_pre_cb,                   /* DC pin in ISR */
    };
    ESP_ERROR_CHECK(spi_bus_add_device(ST7789_SPI_HOST, &dev, &spi_dev));

    /* ── ST7789 init sequence ── */
    lcd_cmd(CMD_SWRESET);
    vTaskDelay(pdMS_TO_TICKS(150));

    lcd_cmd(CMD_SLPOUT);                /* Sleep out */
    vTaskDelay(pdMS_TO_TICKS(120));

    lcd_cmd(CMD_COLMOD);
    lcd_data8(0x55);                    /* 16-bit RGB565 */

    lcd_cmd(CMD_MADCTL);
    lcd_data8(0x00);                    /* Normal orientation */

    lcd_cmd(CMD_INVON);                 /* Inversion on (typical for ST7789) */
    lcd_cmd(CMD_NORON);                 /* Normal display mode */
    lcd_cmd(CMD_DISPON);                /* Display on */
    vTaskDelay(pdMS_TO_TICKS(20));

    /* Backlight on */
    if (ST7789_PIN_BL >= 0) gpio_set_level(ST7789_PIN_BL, 1);

    initialized = true;
    ESP_LOGI(TAG, "ST7789 %dx%d | SPI%d mode0 @%luMHz IOMUX+DMA",
             ST7789_WIDTH, ST7789_HEIGHT, ST7789_SPI_HOST,
             (unsigned long)(dev.clock_speed_hz / 1000000));
    return ESP_OK;
}

/* ═══════════════════════════════════════════════════════
 *  Window & pixel write
 * ═══════════════════════════════════════════════════════ */

void st7789_set_window(uint16_t x0, uint16_t y0, uint16_t x1, uint16_t y1)
{
    /* Drain any pending DMA before sending commands */
    st7789_wait_dma();

    /* CASET: column start/end */
    uint8_t ca[4] = { x0 >> 8, x0 & 0xFF, x1 >> 8, x1 & 0xFF };
    lcd_cmd(CMD_CASET);
    lcd_data(ca, 4);

    /* RASET: row start/end in one 4-byte transfer */
    uint8_t ra[4] = { y0 >> 8, y0 & 0xFF, y1 >> 8, y1 & 0xFF };
    lcd_cmd(CMD_RASET);
    lcd_data(ra, 4);

    /* Begin RAM write */
    lcd_cmd(CMD_RAMWR);
}

void st7789_write_pixels(const uint8_t *data, size_t len)
{
    st7789_wait_dma();
    spi_transaction_t t = {
        .length    = len * 8,
        .tx_buffer = data,
        .user      = (void *)1,
    };
    spi_device_polling_transmit(spi_dev, &t);
}

void st7789_fill_screen(uint16_t color)
{
    st7789_set_window(0, 0, ST7789_WIDTH - 1, ST7789_HEIGHT - 1);

    /* Build one row of the fill color (big-endian byte order for SPI) */
    static uint8_t row[ST7789_WIDTH * 2];
    uint8_t hi = color >> 8, lo = color & 0xFF;
    for (int i = 0; i < ST7789_WIDTH; i++) {
        row[i * 2]     = hi;
        row[i * 2 + 1] = lo;
    }

    /* Send 240 identical rows via polling (same buffer reused) */
    for (int y = 0; y < ST7789_HEIGHT; y++) {
        st7789_write_pixels(row, sizeof(row));
    }
}

void st7789_draw_image(uint16_t x, uint16_t y, uint16_t w, uint16_t h,
                       const uint16_t *rgb565)
{
    if (x + w > ST7789_WIDTH || y + h > ST7789_HEIGHT) return;
    st7789_set_window(x, y, x + w - 1, y + h - 1);
    st7789_write_pixels_dma(rgb565, (size_t)w * h * 2);
}

void st7789_draw_scanline(uint16_t y, uint16_t x, uint16_t w,
                          const uint16_t *rgb565)
{
    if (y >= ST7789_HEIGHT || x + w > ST7789_WIDTH) return;
    st7789_set_window(x, y, x + w - 1, y);
    st7789_write_pixels((const uint8_t *)rgb565, (size_t)w * 2);
}

/* ═══════════════════════════════════════════════════════
 *  Text rendering (8x16 ASCII font)
 * ═══════════════════════════════════════════════════════ */

/* Simple 8x16 font bitmaps for ASCII 32..126 */
static const uint8_t font8x16[95][16] = {
    {0x00,0x00,0x00,0x00,0x00,0x00,0x00,0x00,0x00,0x00,0x00,0x00,0x00,0x00,0x00,0x00}, // 32 ' '
    {0x00,0x00,0x18,0x3c,0x3c,0x3c,0x18,0x18,0x18,0x00,0x18,0x18,0x00,0x00,0x00,0x00}, // 33 !
    {0x00,0x66,0x66,0x66,0x24,0x00,0x00,0x00,0x00,0x00,0x00,0x00,0x00,0x00,0x00,0x00}, // 34 "
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    {0x00,0x3b,0x6e,0x00,0x00,0x00,0x00,0x00,0x00,0x00,0x00,0x00,0x00,0x00,0x00,0x00}, // 126 ~
};

void st7789_draw_char(uint16_t x, uint16_t y, char c, uint16_t color, uint16_t bg)
{
    if (x + 8 > ST7789_WIDTH || y + 16 > ST7789_HEIGHT) return;
    if (c < 32 || c > 126) c = ' ';

    const uint8_t *bmp = font8x16[c - 32];
    uint16_t char_buf[8 * 16];

    /* Byte swap colors for SPI transmission (MSB first) */
    uint16_t fg_swapped = (color >> 8) | (color << 8);
    uint16_t bg_swapped = (bg >> 8) | (bg << 8);

    for (int r = 0; r < 16; r++) {
        uint8_t line = bmp[r];
        for (int b = 0; b < 8; b++) {
            char_buf[r * 8 + b] = (line & (0x80 >> b)) ? fg_swapped : bg_swapped;
        }
    }

    st7789_set_window(x, y, x + 7, y + 15);
    st7789_write_pixels((const uint8_t *)char_buf, sizeof(char_buf));
}

void st7789_draw_string(uint16_t x, uint16_t y, const char *str, uint16_t color, uint16_t bg)
{
    uint16_t cur_x = x;
    uint16_t cur_y = y;

    while (*str) {
        if (*str == '\n') {
            cur_x = x;
            cur_y += 16;
            if (cur_y + 16 > ST7789_HEIGHT) break;
        } else {
            if (cur_x + 8 > ST7789_WIDTH) {
                cur_x = x;
                cur_y += 16;
                if (cur_y + 16 > ST7789_HEIGHT) break;
            }
            st7789_draw_char(cur_x, cur_y, *str, color, bg);
            cur_x += 8;
        }
        str++;
    }
}

void st7789_draw_string_fb(uint16_t *fb, uint16_t x, uint16_t y, const char *str, uint16_t color, uint16_t bg)
{
    if (!fb) return;
    uint16_t cur_x = x;
    uint16_t cur_y = y;

    /* NOTE: colors are written NATIVE (not byte-swapped) — callers that blit
     * the fb (e.g. map_render's fb_blit) do the wire byte-swap themselves. */

    while (*str) {
        char c = *str;
        if (c == '\n') {
            cur_x = x;
            cur_y += 16;
            if (cur_y + 16 > ST7789_HEIGHT) break;
        } else {
            if (cur_x + 8 > ST7789_WIDTH) {
                cur_x = x;
                cur_y += 16;
                if (cur_y + 16 > ST7789_HEIGHT) break;
            }
            if (c < 32 || c > 126) c = ' ';
            const uint8_t *bmp = font8x16[c - 32];

            for (int r = 0; r < 16; r++) {
                int py = cur_y + r;
                if (py >= ST7789_HEIGHT) continue;
                uint8_t line = bmp[r];
                for (int b = 0; b < 8; b++) {
                    int px = cur_x + b;
                    if (px >= ST7789_WIDTH) continue;
                    fb[py * ST7789_WIDTH + px] = (line & (0x80 >> b)) ? color : bg;
                }
            }
            cur_x += 8;
        }
        str++;
    }
}

void st7789_draw_string_fb_scaled(uint16_t *fb, uint16_t x, uint16_t y,
                                  const char *str, uint8_t scale,
                                  uint16_t color, uint16_t bg)
{
    if (!fb || scale < 1) return;
    uint16_t cur_x = x;
    uint16_t cur_y = y;

    while (*str) {
        char c = *str;
        if (c == '\n') {
            cur_x = x;
            cur_y += 16 * scale;
        } else {
            if (c < 32 || c > 126) c = ' ';
            const uint8_t *bmp = font8x16[c - 32];
            for (int r = 0; r < 16; r++) {
                uint8_t line = bmp[r];
                for (int b = 0; b < 8; b++) {
                    uint16_t col = (line & (0x80 >> b)) ? color : bg;
                    for (int sy = 0; sy < scale; sy++) {
                        int py = cur_y + r * scale + sy;
                        if (py >= ST7789_HEIGHT) continue;
                        for (int sx = 0; sx < scale; sx++) {
                            int px = cur_x + b * scale + sx;
                            if (px >= ST7789_WIDTH) continue;
                            fb[py * ST7789_WIDTH + px] = col;
                        }
                    }
                }
            }
            cur_x += 8 * scale;
        }
        str++;
    }
}

/* ═══════════════════════════════════════════════════════
 *  Backlight & deinit
 * ═══════════════════════════════════════════════════════ */

void st7789_backlight(uint8_t pct)
{
    if (ST7789_PIN_BL < 0) return;
    gpio_set_level(ST7789_PIN_BL, (pct > 0) ? 1 : 0);
}

void st7789_deinit(void)
{
    st7789_wait_dma();
    st7789_backlight(0);
    lcd_cmd(CMD_SLPIN);
    if (spi_dev) {
        spi_bus_remove_device(spi_dev);
        spi_dev = NULL;
    }
    spi_bus_free(ST7789_SPI_HOST);
    initialized = false;
}

